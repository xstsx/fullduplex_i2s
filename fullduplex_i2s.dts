/dts-v1/;
/plugin/;

/ {
    compatible = "brcm,bcm2708";

    fragment@0 {
        target = <&sound>;
        __overlay__ {
            compatible = "simple-audio-card";
            simple-audio-card,name = "FullDuplex I2S";

            status="okay";

            capture_link: simple-audio-card,dai-link@0 {
                format = "i2s";
		bitclock-master = <&r_codec_dai>; /* Master , <&r_cpu_dai> for Slave */ 
		frame-master = <&r_codec_dai>; /* Master , <&r_cpu_dai> for Slave */ 

                r_cpu_dai: cpu {
                    sound-dai = <&i2s>;

/* example TDM slot configuration
                    dai-tdm-slot-num = <2>;
                    dai-tdm-slot-width = <32>;
*/
                };

                r_codec_dai: codec {
                    sound-dai = <&codec_in>;
                };
            };

            playback_link: simple-audio-card,dai-link@1 {
                format = "i2s";
		bitclock-master = <&p_codec_dai>; /* Master , <&p_cpu_dai> for Slave */ 
		frame-master = <&p_codec_dai>; /* Master , <&p_cpu_dai> for Slave */ 

                p_cpu_dai: cpu {
                    sound-dai = <&i2s>;

/* example TDM slot configuration
                    dai-tdm-slot-num = <2>; /* 2 channels - 2 words */
                    dai-tdm-slot-width = <32>; /* 32bit for each channel, any way spdif limited to 24bit*/
*/
                };

                p_codec_dai: codec {
                    sound-dai = <&codec_out>;
                };
            };
        };
    };

    fragment@1 {
        target-path = "/";
        __overlay__ {
            codec_out: spdif-transmitter {
                #address-cells = <0>;
                #size-cells = <0>;
                #sound-dai-cells = <0>;
                compatible = "linux,spdif-dit"; /* spdif transmiter */
                status = "okay";
            };
            codec_in: spdif-receiver {
                #address-cells = <0>;
                #size-cells = <0>;
                #sound-dai-cells = <0>;
                compatible = "linux,spdif-dir"; /* spdif receiver */
                status = "okay";
            };
        };
    };

    fragment@2 {
        target = <&i2s>;
        __overlay__ {
            #sound-dai-cells = <0>;
            status = "okay";
        };
    };
};

/* compile with:
   dtc -@ -H epapr -O dtb -o fullduplex_i2s.dtbo -Wno-unit_address_vs_reg fullduplex_i2s.dts
*/
